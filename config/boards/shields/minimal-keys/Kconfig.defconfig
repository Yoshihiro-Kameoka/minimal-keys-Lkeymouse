## config/boards/shields/minimal-keys/Kconfig.defconfig
```kconfig
if SHIELD_MINIMAL_KEYS_R

config ZMK_KEYBOARD_NAME
    default "minimal-keys_R"

config ZMK_SPLIT
    default y

config ZMK_SPLIT_ROLE_CENTRAL
    default y

config ZMK_BLE
    default y

config INPUT
    default y

config ZMK_POINTING
    default y

config SPI
    default y

config PMW3610
    default y

endif

if SHIELD_MINIMAL_KEYS_L

config ZMK_KEYBOARD_NAME
    default "minimal-keys_L"

config ZMK_SPLIT
    default y

endif

if SHIELD_MINIMAL_KEYS_R || SHIELD_MINIMAL_KEYS_L

config NFCT_PINS_AS_GPIOS
    default y

endif
```

## config/west.yml
```yaml
manifest:
  remotes:
    - name: zmkfirmware
      url-base: https://github.com/zmkfirmware
    - name: badjeff
      url-base: https://github.com/badjeff
    - name: hyhy-masa
      url-base: https://github.com/hyhy-masa
    - name: caksoylar
      url-base: https://github.com/caksoylar
    - name: zettaface
      url-base: https://github.com/zettaface

  projects:
    - name: zmk
      remote: zmkfirmware
      revision: v0.3
      import: app/west.yml
    - name: zmk-pmw3610-driver
      remote: hyhy-masa
      revision: 1d9c2c68
    - name: zmk-rgbled-widget
      remote: caksoylar
      revision: v0.3
    - name: zmk-input-processor-keybind
      remote: zettaface
      revision: main

  self:
    path: config
```
